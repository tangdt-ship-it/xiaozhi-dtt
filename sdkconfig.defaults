## sdkconfig.defaults
```kconfig
CONFIG_ESPTOOLPY_FLASHSIZE_16MB=y
CONFIG_ESPTOOLPY_FLASHSIZE="16MB"
CONFIG_SPIRAM=y
CONFIG_SPIRAM_MODE_OCT=y
CONFIG_SPIRAM_SPEED_80M=y
CONFIG_SPIRAM_USE_MALLOC=y
CONFIG_SPIRAM_MALLOC_ALWAYSINTERNAL=16384
CONFIG_SPIRAM_TRY_ALLOCATE_WIFI_LWIP=y

# Xiaozhi target defaults for the DTT ESP32-S3 N16R8 hardware.
CONFIG_LANGUAGE_VI_VN=y
CONFIG_USE_AFE_WAKE_WORD=y
CONFIG_USE_AUDIO_PROCESSOR=y
CONFIG_CUSTOM_WAKE_WORD="hello"
CONFIG_CUSTOM_WAKE_WORD_DISPLAY="Hello"
```

## upstream_xiaozhi/sdkconfig.defaults
```kconfig
CONFIG_COMPILER_OPTIMIZATION_SIZE=y
CONFIG_COMPILER_CXX_EXCEPTIONS=y
CONFIG_COMPILER_CXX_EXCEPTIONS_EMG_POOL_SIZE=1024
CONFIG_COMPILER_CXX_RTTI=y

CONFIG_BOOTLOADER_COMPILER_OPTIMIZATION_PERF=y
CONFIG_BOOTLOADER_LOG_LEVEL_NONE=y
CONFIG_BOOTLOADER_SKIP_VALIDATE_ALWAYS=y
CONFIG_BOOTLOADER_APP_ROLLBACK_ENABLE=y

CONFIG_HTTPD_MAX_REQ_HDR_LEN=2048
CONFIG_HTTPD_MAX_URI_LEN=2048

CONFIG_PARTITION_TABLE_CUSTOM=y
CONFIG_PARTITION_TABLE_CUSTOM_FILENAME="partitions/v2/16m.csv"
CONFIG_PARTITION_TABLE_OFFSET=0x8000

CONFIG_ESP_TASK_WDT_TIMEOUT_S=10
CONFIG_FREERTOS_GENERATE_RUN_TIME_STATS=y
CONFIG_FREERTOS_USE_STATS_FORMATTING_FUNCTIONS=y

CONFIG_ESP_MAIN_TASK_STACK_SIZE=8192
CONFIG_MBEDTLS_DYNAMIC_BUFFER=y
CONFIG_MBEDTLS_SSL_KEEP_PEER_CERTIFICATE=n
CONFIG_ESP_WIFI_IRAM_OPT=n
CONFIG_ESP_WIFI_RX_IRAM_OPT=n
CONFIG_ESP_WIFI_DYNAMIC_RX_MGMT_BUFFER=y

# These entries are copied from ESP-HI (ESP32C3) to reduce memory usage
CONFIG_ESP_WIFI_STATIC_RX_BUFFER_NUM=6
CONFIG_ESP_WIFI_DYNAMIC_RX_BUFFER_NUM=8
CONFIG_NEWLIB_NANO_FORMAT=y
CONFIG_ESP_WIFI_ENTERPRISE_SUPPORT=n

CONFIG_CODEC_I2C_BACKWARD_COMPATIBLE=n

# Fix ML307 FIFO Overflow
CONFIG_UART_ISR_IN_IRAM=y

# Fix ESP_SSL error
CONFIG_MBEDTLS_SSL_RENEGOTIATION=n

# LVGL 9.2.2

CONFIG_LV_OS_NONE=y
CONFIG_LV_USE_CLIB_MALLOC=y
CONFIG_LV_USE_CLIB_STRING=y
CONFIG_LV_USE_CLIB_SPRINTF=y
CONFIG_LV_USE_IMGFONT=y
CONFIG_LV_USE_ASSERT_STYLE=y

# Use compressed font
CONFIG_LV_FONT_FMT_TXT_LARGE=y
CONFIG_LV_USE_FONT_COMPRESSED=n
CONFIG_LV_USE_FONT_PLACEHOLDER=n
CONFIG_LV_USE_LODEPNG=y

# Disable extra widgets to save flash size
CONFIG_LV_USE_ANIMIMG=n
CONFIG_LV_USE_CALENDAR=n
CONFIG_LV_USE_CALENDAR_HEADER_ARROW=n
CONFIG_LV_USE_CALENDAR_HEADER_DROPDOWN=n
CONFIG_LV_USE_CHART=n
CONFIG_LV_USE_KEYBOARD=n
CONFIG_LV_USE_LED=n
CONFIG_LV_USE_LIST=n
CONFIG_LV_USE_MENU=n
CONFIG_LV_USE_MSGBOX=n
CONFIG_LV_USE_SPAN=n
CONFIG_LV_USE_SPINBOX=n
CONFIG_LV_USE_SPINNER=n
CONFIG_LV_USE_TABVIEW=n
CONFIG_LV_USE_TILEVIEW=n
CONFIG_LV_USE_WIN=n

CONFIG_LV_BUILD_EXAMPLES=n
CONFIG_LV_BUILD_DEMOS=n

# DTT ESP32-S3 N16R8 defaults
CONFIG_BOARD_TYPE_DTT_ESP32=y
CONFIG_LANGUAGE_VI_VN=y
CONFIG_OLED_SSD1306_128X32=y
CONFIG_USE_CUSTOM_WAKE_WORD=y
CONFIG_CUSTOM_WAKE_WORD="hello"
CONFIG_CUSTOM_WAKE_WORD_DISPLAY="Xin chào"
CONFIG_CUSTOM_WAKE_WORD_THRESHOLD=18
# CONFIG_SR_WN_WN9S_HILEXIN is not set
# CONFIG_SR_WN_WN9S_HIESP is not set
# CONFIG_SR_WN_WN9S_NIHAOXIAOZHI is not set
# CONFIG_SR_WN_WN9S_HIJASON is not set
# CONFIG_SR_WN_WN9_HILEXIN is not set
# CONFIG_SR_WN_WN9_NIHAOMIAOBAN_TTS2 is not set
# CONFIG_SR_WN_WN9_XIAOAITONGXUE is not set
# CONFIG_SR_WN_WN9L_XIAOAITONGXUE is not set
# CONFIG_SR_WN_WN9_NIHAOXIAOZHI_TTS is not set
# CONFIG_SR_WN_WN9L_NIHAOXIAOZHI_TTS3 is not set
# CONFIG_SR_WN_WN9_ALEXA is not set
# CONFIG_SR_WN_WN9_HIESP is not set
# CONFIG_SR_WN_WN9_JARVIS_TTS is not set
# CONFIG_SR_WN_WN9_COMPUTER_TTS is not set
# CONFIG_SR_WN_WN9_HEYWILLOW_TTS is not set
# CONFIG_SR_WN_WN9_HIMFIVE is not set
# CONFIG_SR_WN_WN9_SOPHIA_TTS is not set
# CONFIG_SR_WN_WN9_HEYWANDA_TTS is not set
# CONFIG_SR_WN_WN9_HIJOLLY_TTS2 is not set
# CONFIG_SR_WN_WN9_HIFAIRY_TTS2 is not set
# CONFIG_SR_WN_WN9_HEYPRINTER_TTS is not set
# CONFIG_SR_WN_WN9_MYCROFT_TTS is not set
# CONFIG_SR_WN_WN9_HIJOY_TTS is not set
# CONFIG_SR_WN_WN9_HIJASON_TTS2 is not set
# CONFIG_SR_WN_WN9_ASTROLABE_TTS is not set
# CONFIG_SR_WN_WN9_HEYILY_TTS2 is not set
# CONFIG_SR_WN_WN9_BLUECHIP_TTS2 is not set
# CONFIG_SR_WN_WN9_HIANDY_TTS2 is not set
# CONFIG_SR_WN_WN9_HEYIVY_TTS2 is not set
# CONFIG_SR_WN_WN9_HISTACKCHAN_TTS3 is not set
# CONFIG_SR_WN_WN9_HEYKIRA_TTS3 is not set
# CONFIG_SR_WN_WN9_XIAOLONGXIAOLONG_TTS is not set
# CONFIG_SR_WN_WN9_HIMIAOMIAO_TTS is not set
# CONFIG_SR_WN_WN9_MIAOMIAOTONGXUE_TTS is not set
# CONFIG_SR_WN_WN9_NIHAOXIAOXIN_TTS is not set
# CONFIG_SR_WN_WN9_XIAOMEITONGXUE_TTS is not set
# CONFIG_SR_WN_WN9_HILILI_TTS is not set
# CONFIG_SR_WN_WN9_HITELLY_TTS is not set
# CONFIG_SR_WN_WN9_XIAOBINXIAOBIN_TTS is not set
# CONFIG_SR_WN_WN9_HAIXIAOWU_TTS is not set
# CONFIG_SR_WN_WN9_XIAOYAXIAOYA_TTS2 is not set
# CONFIG_SR_WN_WN9_LINAIBAN_TTS2 is not set
# CONFIG_SR_WN_WN9_XIAOSUROU_TTS2 is not set
# CONFIG_SR_WN_WN9_XIAOYUTONGXUE_TTS2 is not set
# CONFIG_SR_WN_WN9_XIAOMINGTONGXUE_TTS2 is not set
# CONFIG_SR_WN_WN9_XIAOKANGTONGXUE_TTS2 is not set
# CONFIG_SR_WN_WN9_XIAOJIANXIAOJIAN_TTS2 is not set
# CONFIG_SR_WN_WN9_XIAOTEXIAOTE_TTS2 is not set
# CONFIG_SR_WN_WN9_NIHAOXIAOYI_TTS2 is not set
# CONFIG_SR_WN_WN9_NIHAOBAIYING_TTS2 is not set
# CONFIG_SR_WN_WN9_NIHAODONGDONG_TTS2 is not set
# CONFIG_SR_WN_WN9_HIWALLE_TTS2 is not set
# CONFIG_SR_WN_WN9_XIAOLUXIAOLU_TTS2 is not set
# CONFIG_SR_WN_WN9_NIHAOXIAOAN_TTS2 is not set
# CONFIG_SR_WN_WN9_NI3HAO3XIAO3MAI4_TTS2 is not set
# CONFIG_SR_WN_WN9_NI3HAO3XIAO3RUI4_TTS3 is not set
# CONFIG_SR_WN_WN9_HAI1XIAO3OU1_TTS3 is not set
# CONFIG_SR_WN_WN9_XIAO3JIA1XIAO3JIA1_TTS3 is not set
# CONFIG_SR_WN_WN9_XIAO3FENG1XIAO3FENG1_TTS3 is not set
# CONFIG_SR_WN_WN9_HAI1XIAO3XIANG4_TTS3 is not set
# CONFIG_SR_MN_EN_NONE is not set
# CONFIG_SR_MN_EN_MULTINET5_SINGLE_RECOGNITION_QUANT8 is not set
# CONFIG_SR_MN_EN_MULTINET6_QUANT is not set
CONFIG_SR_MN_EN_MULTINET7_QUANT=y
```
